## drivers/input/touchscreen/MMS136/Kconfig
```kconfig
#
# touch driver configuration
#

config TOUCHSCREEN_MELFAS_MMS136
	tristate "Melfas MMS136 I2C Touchscreen"
	depends on I2C
	help
	  Say Y here if you have Melfas MMS136 I2C touchscreen,
	  such as MMS136, connected to your system.

	  If unsure, say N.

	  To compile this driver as a module, choose M here: the
	  module will be called MMS136.
```

## drivers/input/touchscreen/zinitix/Kconfig
```kconfig
#
# ZINITIX Touchscreen driver configuration
#

source "drivers/input/touchscreen/zinitix/lt06/Kconfig"
```

## drivers/input/touchscreen/zinitix/lt06/Kconfig
```kconfig
#
# ZINITIX Touchscreen driver configuration
#

config TOUCHSCREEN_BT532
	tristate "ZINITIX touchscreen driver"
	depends on I2C
	help
	  Say Y here if you have a ZINITIX touchscreen.
```
